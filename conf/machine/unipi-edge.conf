## conf/machine/unipi-edge.conf
```bitbake
#@TYPE: Machine
#@NAME: Unipi Edge PLC with CM40
#@DESCRIPTION: Machine configuration for Unipi Edge in 64 bits mode

MACHINEOVERRIDES =. "raspberrypi4:"

#MACHINE_FEATURES += "pci"
MACHINE_EXTRA_RRECOMMENDS += "\
    linux-firmware-rpidistro-bcm43455 \
    bluez-firmware-rpidistro-bcm4345c0-hcd \
    linux-firmware-rpidistro-bcm43456 \
    bluez-firmware-rpidistro-bcm4345c5-hcd \
    kernel-module-unipi-id \
    kernel-module-unipi-rfkill \
    kernel-module-unipi-mfds \
    unipi-modbus-tools \
    unipi-firmware-tools \
"
MACHINE_EXTRA_RRECOMMENDS += "${@bb.utils.contains('RPI_USE_U_BOOT', '1', 'u-boot-default-script', '', d)}"

require conf/machine/include/arm/armv8a/tune-cortexa72.inc
include conf/machine/include/rpi-base.inc

RPI_KERNEL_DEVICETREE = "broadcom/bcm2711-rpi-cm4.dtb"
RPI_KERNEL_DEVICETREE_OVERLAYS = "\
    overlays/vc4-kms-v3d-pi4.dtbo \
    overlays/unipi_uboot_tpm.dtbo \
    overlays/unipi_uboot.dtbo \
    overlays/unipi_e10300.dtbo \
    overlays/ud00cb.dtbo \
    overlays/antenna2.dtbo \
"
# install dtb and dtbo into directories (broadcom, overlays)
KERNEL_DTBVENDORED = "${@bb.utils.contains('RPI_USE_U_BOOT', '1', '1', '0', d)}"

SDIMG_KERNELIMAGE ?= "kernel8.img"
SERIAL_CONSOLES = "115200;ttyAMA1"

PREFERRED_PROVIDER_u-boot-default-script ?= "unipi-u-boot-scr"
PREFERRED_PROVIDER_virtual/bootloader ?= "u-boot"
EXTRA_IMAGEDEPENDS += "virtual/bootloader"

UBOOT_MACHINE ?= "unipi_edge_config"

VC4DTBO ?= "vc4-kms-v3d"


RPI_EXTRA_IMAGE_BOOT_FILES = " \
        ${@bb.utils.contains('RPI_USE_U_BOOT', '1', \
                'u-boot.bin', \
                '${KERNEL_IMAGETYPE};${SDIMG_KERNELIMAGE}', d)} \
        "

KERNEL_IMAGETYPE_UBOOT ?= "Image.gz"
KERNEL_IMAGETYPE_DIRECT ?= "Image.gz"

KERNEL_BOOTCMD ?= "booti"

#ARMSTUB ?= "armstub8-gic.bin"
```

## meta-unipi/conf/machine/unipi-2711.inc
```bitbake
WKS_FILE ?= "sdimage-unipi.wks"

require conf/machine/include/arm/armv8a/tune-cortexa72.inc
include conf/machine/include/rpi-base.inc
include conf/machine/unipi-2711-scr.inc

#MACHINE_FEATURES += "pci"
MACHINE_EXTRA_RRECOMMENDS += "\
    kernel-module-unipi-id \
    kernel-module-unipi-rfkill \
    unipi-os-configurator-switchboot \
    unipi-os-configurator-base \
"
MACHINE_ESSENTIAL_EXTRA_RDEPENDS += "${@bb.utils.contains('RPI_USE_U_BOOT', '1', 'u-boot-default-script', '', d)}"


# rpi-base.inc expects no RTC, but this machine has one
MACHINE_FEATURES_BACKFILL_CONSIDERED:remove = "rtc"

## clear some defaults from MACHINE_FEATURES
## this removes packagegroup-base-wifi... from RDEPENDS:packagegroup-base
## but not from RDEPENDS:packagegroup-base-extended
MACHINE_FEATURES:remove = "alsa"

## disable installing 3g,wifi,nfc,zeroconf if not in MACHINE_FEATURES
## or explicitly specified in IMAGE_INSTALL
RDEPENDS:packagegroup-base-extended:remove = "packagegroup-base-3g"
RDEPENDS:packagegroup-base-extended:remove = "packagegroup-base-wifi"
RDEPENDS:packagegroup-base-extended:remove = "packagegroup-base-bluetooth"
RDEPENDS:packagegroup-base-extended:remove = "packagegroup-base-nfc"
RDEPENDS:packagegroup-base:remove = "packagegroup-base-zeroconf"
RDEPENDS:packagegroup-core-base-utils:remove = "inetutils"

# install dtb and dtbo into directories (broadcom, overlays)
KERNEL_DTBVENDORED = "${@bb.utils.contains('RPI_USE_U_BOOT', '1', '1', '0', d)}"

SDIMG_KERNELIMAGE ?= " \
        ${@bb.utils.contains('RPI_USE_U_BOOT', '1', \
                'u-boot.bin', \
                'kernel8.img', d)} \
        "

# Avoid re-generating fstab when ima is enabled.
WIC_CREATE_EXTRA_ARGS:append = " --no-fstab-update"

# disable serial console in Linux
SERIAL_CONSOLES = ""

PREFERRED_VERSION_linux-raspberrypi ?= "6.12.%"

PREFERRED_PROVIDER_u-boot-default-script ?= "unipi-u-boot-scr"
PREFERRED_PROVIDER_virtual/bootloader ?= "u-boot"
EXTRA_IMAGEDEPENDS += "virtual/bootloader"

# setup second (rootfs) partition as active instead of first FAT
IMAGE_CLASSES += "${@bb.utils.contains('RPI_USE_U_BOOT', '1', 'activate_part', '', d)}"

VC4DTBO ?= "vc4-kms-v3d"


RPI_EXTRA_IMAGE_BOOT_FILES = " \
        ${@bb.utils.contains('RPI_USE_U_BOOT', '1', \
                'u-boot.bin', \
                '${KERNEL_IMAGETYPE};${SDIMG_KERNELIMAGE}', d)} \
        "

KERNEL_IMAGETYPE_UBOOT ?= "Image.gz"
KERNEL_IMAGETYPE_DIRECT ?= "Image.gz"

KERNEL_BOOTCMD ?= "booti"

#ARMSTUB ?= "armstub8-gic.bin"

############# Rules for building RPIBOOT image required by RPi Secure boot
# RPI_USE_RPIBOOT = "1"
# RPI_USE_SIGNEDBOOT = "1"

EXTRA_IMAGEDEPENDS += "${@bb.utils.contains('RPI_USE_RPIBOOT', '1', 'rpiboot-container', '', d)}"
EXTRA_IMAGEDEPENDS += "${@bb.utils.contains('RPI_USE_SIGNEDBOOT', '1', 'rpiboot-sign', '', d)}"

# list of files installed to bootimage
RPIBOOT_IMAGE_FILES = "${BOOTFILES_DIR_NAME}/* \
                       ${@make_dtb_boot_files(d)} \
                       ${RPI_EXTRA_IMAGE_BOOT_FILES} \
                      "

# list of files installed to native boot partition
IMAGE_BOOT_FILES = "${@bb.utils.contains('RPI_USE_SIGNEDBOOT', '1', \
                        'boot.img config.txt boot.sig', \
                      bb.utils.contains('RPI_USE_RPIBOOT', '1', \
                        'boot.img config.txt', \
                        '${RPIBOOT_IMAGE_FILES}', d), d)}"
```

## meta-unipi/conf/machine/unipi-edge.inc
```bitbake
include conf/machine/unipi-2711.inc

MACHINEOVERRIDES =. "raspberrypi4:unipi_edge:"

RPI_KERNEL_DEVICETREE = "broadcom/bcm2711-rpi-cm4.dtb"

BOOTIMG_DEVICETREE_OVERLAYS ?= "\
    overlays/vc4-kms-v3d-pi4.dtbo \
    overlays/unipi_uboot_tpm.dtbo \
    overlays/unipi_uboot.dtbo \
"

RPI_KERNEL_DEVICETREE_OVERLAYS = "\
    ${BOOTIMG_DEVICETREE_OVERLAYS} \
    overlays/unipi_e410.dtbo \
    overlays/unipi_e411.dtbo \
    overlays/unipi_e412.dtbo \
    overlays/unipi_e413.dtbo \
    overlays/unipi_e414.dtbo \
    overlays/unipi_e415.dtbo \
    overlays/antenna1.dtbo \
    overlays/disable_wifi.dtbo \
    overlays/disable_bt.dtbo \
"
BOOTIMG_DEVICETREE = "${RPI_KERNEL_DEVICETREE} ${BOOTIMG_DEVICETREE_OVERLAYS}"

UBOOT_MACHINE ?= "unipi-edge_config"
```

## meta-unipi/conf/machine/unipi-neuron.inc
```bitbake
include conf/machine/unipi-2711.inc

MACHINEOVERRIDES =. "raspberrypi4:unipi_neuron:"

RPI_KERNEL_DEVICETREE = "broadcom/bcm2711-rpi-4-b.dtb"

BOOTIMG_DEVICETREE_OVERLAYS ?= "\
     overlays/vc4-kms-v3d-pi4.dtbo \
     overlays/unipi_uboot.dtbo \
"

RPI_KERNEL_DEVICETREE_OVERLAYS = "\
     ${BOOTIMG_DEVICETREE_OVERLAYS} \
     overlays/unipi_s103.dtbo \
     overlays/antenna1.dtbo \
     overlays/disable_wifi.dtbo \
     overlays/disable_bt.dtbo \
"
BOOTIMG_DEVICETREE = "${RPI_KERNEL_DEVICETREE} ${BOOTIMG_DEVICETREE_OVERLAYS}"

UBOOT_MACHINE ?= "unipi-edge_config"

MACHINE_FEATURES += "bluetooth"
MACHINE_FEATURES += "wifi"

MACHINE_EXTRA_RRECOMMENDS += "\
    kernel-module-unipi-mfds \
    unipi-modbus-tools \
    unipi-firmware-tools \
    linux-firmware-rpidistro-bcm43455 \
    bluez-firmware-rpidistro-bcm4345c0-hcd \
    linux-firmware-rpidistro-bcm43456 \
    bluez-firmware-rpidistro-bcm4345c5-hcd \
"
```

## meta-unipi/conf/machine/unipi_features.inc
```bitbake
MACHINE_FIRMWARE:append = " ${@bb.utils.contains('MACHINE_FEATURES', 'unipi-id', 'kernel-module-unipi-id kernel-module-unipi-rfkill kernel-module-unipi-mfd', '', d)}"
```
