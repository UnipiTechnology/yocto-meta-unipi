/dts-v1/;
/plugin/;

/ {
	fragment@0 {
		target = <&ant1>;
		__overlay__ {
			status = "okay";
		};
	};
	fragment@1 {
		target = <&ant2>;
		__overlay__ {
			status = "okay";
		};
	};
	fragment@2 {
		target = <&ant1alt>;
		__overlay__ {
			status = "disabled";
		};
	};
	fragment@3 {
		target = <&ant2alt>;
		__overlay__ {
			status = "disabled";
		};
	};
};
